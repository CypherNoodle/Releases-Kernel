## samsung_np300e4c_defconfig
```kconfig
# Optimized defconfig for Samsung NP300E4C (Sandy Bridge - Celeron B820)
# Target: high performance, stability, and high security.

# CPU & Base System
CONFIG_64BIT=y
CONFIG_X86_64=y
CONFIG_SMP=y
CONFIG_MCORE2=y
CONFIG_NR_CPUS=4
CONFIG_PREEMPT_VOLUNTARY=y
CONFIG_HZ_1000=y
CONFIG_SCHED_AUTOGROUP=y
CONFIG_CC_OPTIMIZE_FOR_PERFORMANCE=y
CONFIG_UNIX=y
CONFIG_SHMEM=y
CONFIG_TMPFS=y
CONFIG_TMPFS_POSIX_ACL=y
CONFIG_IKCONFIG=y
CONFIG_IKCONFIG_PROC=y

# Security (KSPP & Hardening)
CONFIG_FORTIFY_SOURCE=y
CONFIG_HARDENED_USERCOPY=y
CONFIG_STRICT_KERNEL_RWX=y
CONFIG_STRICT_MODULE_RWX=y
CONFIG_PAGE_TABLE_ISOLATION=y
CONFIG_RETPOLINE=y
CONFIG_RANDOMIZE_BASE=y
CONFIG_RANDOMIZE_MEMORY=y
CONFIG_X86_SMAP=y
CONFIG_X86_UMIP=y
CONFIG_STACKPROTECTOR=y
CONFIG_STACKPROTECTOR_STRONG=y
CONFIG_LEGACY_VSYSCALL_NONE=y
CONFIG_REFCOUNT_FULL=y
CONFIG_SLUB_DEBUG=y

# Processor features
CONFIG_X86_MCE=y
CONFIG_X86_MCE_INTEL=y
CONFIG_MICROCODE=y
CONFIG_MICROCODE_INTEL=y
CONFIG_X86_MSR=y
CONFIG_X86_CPUID=y

# Power management
CONFIG_CPU_FREQ=y
CONFIG_CPU_FREQ_DEFAULT_GOV_SCHEDUTIL=y
CONFIG_CPU_FREQ_GOV_PERFORMANCE=y
CONFIG_CPU_FREQ_GOV_POWERSAVE=y
CONFIG_INTEL_IDLE=y
CONFIG_ACPI=y
CONFIG_X86_INTEL_PSTATE=y
CONFIG_PM=y
CONFIG_PM_SLEEP=y
CONFIG_SUSPEND=y

# Bus options
CONFIG_PCI=y
CONFIG_PCIEPORTBUS=y
CONFIG_HOTPLUG_PCI=y
CONFIG_PCI_MSI=y

# Storage Drivers
CONFIG_ATA=y
CONFIG_SATA_AHCI=y
CONFIG_SATA_AHCI_PLATFORM=y
CONFIG_BLK_DEV_SD=y
CONFIG_CHR_DEV_SG=y
CONFIG_MMC=m
CONFIG_MMC_BLOCK=m
CONFIG_MMC_SDHCI=m
CONFIG_MMC_SDHCI_PCI=m

# Crypto Hardware Support
CONFIG_CRYPTO_AES_NI_INTEL=m
CONFIG_CRYPTO_AES_X86_64=y
CONFIG_CRYPTO_SHA256_SSSE3=y
CONFIG_CRYPTO_SHA512_SSSE3=y

# Device Drivers
CONFIG_DRM=y
CONFIG_DRM_I915=y
CONFIG_FB=y
CONFIG_SND=y
CONFIG_SND_HDA_INTEL=y
CONFIG_SND_HDA_CODEC_REALTEK=y
CONFIG_SND_HDA_CODEC_HDMI=y
CONFIG_I2C=y
CONFIG_I2C_I801=y
CONFIG_LPC_ICH=y
CONFIG_INTEL_MEI=m
CONFIG_INTEL_MEI_ME=m

# USB Support
CONFIG_USB=y
CONFIG_USB_XHCI_HCD=y
CONFIG_USB_EHCI_HCD=y
CONFIG_USB_UHCI_HCD=y
CONFIG_USB_HID=y
CONFIG_USB_HIDDEV=y
CONFIG_USB_HIDRAW=y
CONFIG_HID_GENERIC=y

# Multimedia support (Webcam)
CONFIG_MEDIA_SUPPORT=m
CONFIG_MEDIA_CAMERA_SUPPORT=y
CONFIG_VIDEO_V4L2=m
CONFIG_VIDEO_V4L2_I2C=y
CONFIG_VIDEO_USB_TVV4L2=m
CONFIG_USB_VIDEO_CLASS=m
CONFIG_USB_GSPCA=m

# Networking
CONFIG_NET=y
CONFIG_INET=y
CONFIG_WIRELESS=y
CONFIG_WLAN=y
CONFIG_ATH_COMMON=m
CONFIG_ATH9K=m
CONFIG_R8169=m
CONFIG_TCP_CONG_BBR=y
CONFIG_DEFAULT_TCP_CONG="bbr"

# Bluetooth support
CONFIG_BT=m
CONFIG_BT_RFCOMM=m
CONFIG_BT_RFCOMM_TTY=y
CONFIG_BT_BNEP=m
CONFIG_BT_BNEP_MC_FILTER=y
CONFIG_BT_BNEP_PROTO_FILTER=y
CONFIG_BT_HIDP=m
CONFIG_BT_HS=y
CONFIG_BT_LE=y
CONFIG_BT_HCIBTUSB=m
CONFIG_BT_HCIBTUSB_BCM=y
CONFIG_BT_HCIBTUSB_RTL=y
CONFIG_BT_HCIUART=m
CONFIG_BT_HCIUART_H4=y
CONFIG_BT_HCIUART_BCSP=y
CONFIG_BT_HCIUART_ATH3K=y
CONFIG_BT_ATH3K=m

# Input devices
CONFIG_INPUT=y
CONFIG_INPUT_MOUSEDEV=y
CONFIG_INPUT_JOYDEV=m
CONFIG_INPUT_EVDEV=y
CONFIG_INPUT_KEYBOARD=y
CONFIG_KEYBOARD_ATKBD=y
CONFIG_INPUT_MOUSE=y
CONFIG_MOUSE_PS2=y
CONFIG_MOUSE_PS2_ALPS=y
CONFIG_MOUSE_PS2_BYPASS=y
CONFIG_MOUSE_PS2_SYNAPTICS=y
CONFIG_MOUSE_PS2_LIFEBOOK=y
CONFIG_MOUSE_PS2_TRACKPOINT=y
CONFIG_MOUSE_PS2_ELANTECH=y
CONFIG_MOUSE_PS2_SENTELIC=y
CONFIG_MOUSE_PS2_TOUCHKIT=y

# Samsung Laptop Extras
CONFIG_SAMSUNG_LAPTOP=m
CONFIG_SAMSUNG_Q10=m
CONFIG_CHROMEOS_LAPTOP=m

# Filesystems
CONFIG_EXT4_FS=y
CONFIG_EXT4_FS_POSIX_ACL=y
CONFIG_EXT4_FS_SECURITY=y
CONFIG_BTRFS_FS=y
CONFIG_BTRFS_FS_POSIX_ACL=y
CONFIG_F2FS_FS=y
CONFIG_VFAT_FS=y
CONFIG_MSDOS_FS=y
CONFIG_FAT_DEFAULT_CODEPAGE=437
CONFIG_FAT_DEFAULT_IOCHARSET="iso8859-1"
CONFIG_NTFS_FS=m
CONFIG_NTFS3_FS=m

# Build options
CONFIG_MODULES=y
CONFIG_MODULE_UNLOAD=y
CONFIG_MODVERSIONS=y
CONFIG_UNUSED_SYMBOLS=n
CONFIG_DEBUG_FS=n
CONFIG_STACK_VALIDATION=y

# EFI
CONFIG_EFI=y
CONFIG_EFIVAR_FS=y
CONFIG_EFI_STUB=y
CONFIG_EFI_MIXED=y

# Compression
CONFIG_KERNEL_GZIP=y

# Additional Stability & Power Drivers
CONFIG_INTEL_IPS=m
CONFIG_THERMAL=y
CONFIG_INTEL_POWERCLAMP=m
CONFIG_X86_PKG_TEMP_THERMAL=m
CONFIG_INTEL_PCH_THERMAL=m

# Dependencies for Sound & Graphics
CONFIG_I2C_DESIGNWARE_PLATFORM=m
CONFIG_I2C_DESIGNWARE_PCI=m
CONFIG_DRM_PANEL_ORIENTATION_QUIRKS=y

# Kernel Performance features
CONFIG_NO_HZ_IDLE=y
CONFIG_HIGH_RES_TIMERS=y
CONFIG_DEVTMPFS=y
CONFIG_DEVTMPFS_MOUNT=y
```
